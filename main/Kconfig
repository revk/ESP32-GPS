## main/Kconfig
```kconfig
menu "GPS"

	config GPS_MOBILE
	bool "Include mobile data support"
	default y 
	help
		Include code to handle a SIM / mobile data module

	config GPS_LOGGING
	bool "Include data logging"
	default y 
	help
		Include code to handle data logging

	config GPS_MICROSD
	bool "Include microSD"
	default y 
	help
		Include microSD

endmenu
```
